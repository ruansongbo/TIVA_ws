#include <stdint.h>
#include <stdbool.h>
#include "inc/hw_memmap.h"
#include "inc/hw_ints.h"
#include "driverlib/pin_map.h"
#include "driverlib/sysctl.h"
#include "driverlib/gpio.h"
#include "driverlib/uart.h"
#include "driverlib/ROM.h"
#include "driverlib/interrupt.h"
#include "utils/uartstdio.h"
#include "string.h"
#include "stdio.h"
#include "OLED.h"
#include "common.h"
#include "gps.h"

#define USART_REC_LEN           200     //定义最大接收字节数 200

nmea_msg gpsx;                                          //GPS信息
unsigned char gImage_ss[768] = {
        0x00,0x00,0x00,0x00,0x00,0x00,0x00,0x00,
        0x00,0x00,0x00,0x00,0x00,0x00,0x00,0x00,
        0x00,0x00,0x00,0x00,0x00,0x00,0x00,0x00,
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        0x00,0x00,0x00,0x00,0x00,0x00,0x00,0x00
};

/*pin_map***************
 *          AmoMcu                 TIVA(SPI0)
 *           D0         -         (SCLK)  PA4
 *           D1         -         (MOSI)  PA5
 *           RST        -           复位             PA6
 *           DC         -        命令数据选择（数据：H 命令：L） PA7
 *           CS         -        片选（已接地）
 */


void systeminit(void)
{
    ROM_SysCtlClockSet(SYSCTL_SYSDIV_4 | SYSCTL_USE_PLL | SYSCTL_OSC_MAIN |
            SYSCTL_XTAL_16MHZ);
}


void InitGPIO(void)
{
    SysCtlPeripheralEnable(SYSCTL_PERIPH_GPIOA);
    GPIOPinTypeGPIOOutput(GPIO_PORTA_BASE, 0xF0);
}
void InitConsole(void)
{
    SysCtlPeripheralEnable(SYSCTL_PERIPH_GPIOA);
    GPIOPinConfigure(GPIO_PA0_U0RX);
    GPIOPinConfigure(GPIO_PA1_U0TX);
    SysCtlPeripheralEnable(SYSCTL_PERIPH_UART0);
    UARTClockSourceSet(UART0_BASE, UART_CLOCK_PIOSC);
    GPIOPinTypeUART(GPIO_PORTA_BASE, GPIO_PIN_0 | GPIO_PIN_1);
    UARTStdioConfig(0, 115200, 16000000);
}
void UARTGPSinit(void)
{
    ROM_SysCtlPeripheralEnable(SYSCTL_PERIPH_UART1);
    ROM_SysCtlPeripheralEnable(SYSCTL_PERIPH_GPIOB);
    GPIOPinConfigure(GPIO_PB0_U1RX);
    GPIOPinConfigure(GPIO_PB1_U1TX);
    ROM_GPIOPinTypeUART(GPIO_PORTB_BASE, GPIO_PIN_0 | GPIO_PIN_1);
    ROM_UARTConfigSetExpClk(UART1_BASE, ROM_SysCtlClockGet(), 115200,
                                (UART_CONFIG_WLEN_8 | UART_CONFIG_STOP_ONE |
                                 UART_CONFIG_PAR_NONE));
    ROM_IntEnable(INT_UART1);
    ROM_UARTIntEnable(UART1_BASE, UART_INT_RX | UART_INT_RT);
}

uint8_t USART_RX_BUF[USART_REC_LEN];     //接收缓冲,最大USART_REC_LEN个字节.
//接收状态
//bit15，    接收完成标志
//bit14，    接收到0x0d
//bit13~0，  接收到的有效字节数目
uint16_t USART_RX_STA=0;       //接收状态标记
uint8_t res;
void
UARTGPSIntHandler(void)
{
    uint32_t ui32Status;
    ui32Status = ROM_UARTIntStatus(UART1_BASE, true);
    ROM_UARTIntClear(UART1_BASE,  ui32Status);
    while(ROM_UARTCharsAvail(UART1_BASE))
    {
        //ROM_UARTCharGetNonBlocking(UART1_BASE);
        //ROM_UARTCharPutNonBlocking(UART0_BASE,ROM_UARTCharGetNonBlocking(UART1_BASE));
        res=ROM_UARTCharGetNonBlocking(UART1_BASE);
        if((USART_RX_STA&0x8000)==0)//接收未完成
        {
            if(USART_RX_STA&0x4000)//接收到了0x0d
            {
                if(res!=0x0a)
                {
                    USART_RX_STA=0;//接收错误,重新开始
                }
                else
                {
                    USART_RX_STA|=0x8000;  //接收完成了
                }
            }
            else //还没收到0X0D
            {
                if(res==0x0d)
                {
                    USART_RX_STA|=0x4000;
                }
                else
                {
                    USART_RX_BUF[USART_RX_STA&0X3FFF]=res;
                    USART_RX_STA++;
                    if(USART_RX_STA>(USART_REC_LEN-1))USART_RX_STA=0;//接收数据错误,重新开始接收
                }
            }
        }
    }
}
uint8_t dtbuf[50];                                //打印缓存器
char *fixmode_tbl[4]={"Fail","Fail"," 2D "," 3D "};  //fix mode字符串
//显示GPS定位信息
void Gps_Msg_Show(void)
{
    int tp;
    //tp=gpsx.longitude;
    tp = 10312;
    sprintf((char *)dtbuf,"Longitude:%d %c   ",tp,gpsx.ewhemi);  //得到经度字符串
    LED_P6x8Str(0,2,dtbuf);
    SysCtlDelay(312500);
    //tp=gpsx.latitude;
    tp = 2311;
    sprintf((char *)dtbuf,"Latitude:%d %1c   ",tp,gpsx.nshemi);   //得到纬度字符串
    LED_P6x8Str(0,3,dtbuf);
    SysCtlDelay(312500);
    //tp=gpsx.altitude;
    tp = 12;
    sprintf((char *)dtbuf,"Altitude:%d     ",tp);                    //得到高度字符串
    LED_P6x8Str(0,4,dtbuf);
    SysCtlDelay(312500);
    //tp=gpsx.speed;
    tp = 123;
    sprintf((char *)dtbuf,"Speed:%dkm/h     ",tp);                  //得到速度字符串
    LED_P6x8Str(0,5,dtbuf);
    SysCtlDelay(312500);
    sprintf((char *)dtbuf,"Valid satellite:%d",gpsx.posslnum);            //用于定位的卫星数
    LED_P6x8Str(0,7,dtbuf);
    SysCtlDelay(312500);
    sprintf((char *)dtbuf,"Visible satellite:%d",gpsx.svnum%100);         //可见卫星数
    LED_P6x8Str(0,2,dtbuf);
    SysCtlDelay(312500);
    sprintf((char *)dtbuf,"UTC Date:%d/%d/%d   ",gpsx.utc.year,gpsx.utc.month,gpsx.utc.date); //显示UTC日期
    //printf("year2:%d\r\n",gpsx.utc.year);
    LED_P6x8Str(0,3,dtbuf);
    SysCtlDelay(312500);
    sprintf((char *)dtbuf,"UTC Time:%d:%d:%d   ",gpsx.utc.hour,gpsx.utc.min,gpsx.utc.sec);    //显示UTC时间
    LED_P6x8Str(0,4,dtbuf);
    SysCtlDelay(312500);
}

/*----------------------------------------------------------------------------*
 * 外部函数原型                                                               *
 *----------------------------------------------------------------------------*/
uint16_t rxlen,i;
float tp;
VOID main(void)
{
    systeminit();
    InitConsole();
    UARTGPSinit();
    InitGPIO();
    LED_Init();
    ROM_IntMasterEnable();
    LED_PXx16MixStr(26, 0, (UCHAR8*)"GPS数据采集");
    my_image_print(gImage_ss);
    SysCtlDelay(3125000);
    my_clear();
    LED_P6x8Str(20,2,"^_^ TIVA_RSB ^_^");
    LED_P6x8Str(20,3,"NE0-6M GPS TEST");
    SysCtlDelay(3125000);
    tp = 1.345;
    gpsx.ewhemi = 'E';
    my_clear();
    Gps_Msg_Show();
    while(1)
    {
        /*if(USART_RX_STA&0X8000)        //接收到一次数据了
        {
            rxlen=USART_RX_STA&0X7FFF; //得到数据长度
            USART_RX_STA=0;            //启动下一次接收
            GPS_Analysis(&gpsx,(uint8_t*)USART_RX_BUF);//分析字符串
            UARTprintf(USART_RX_BUF);
            my_clear();
            Gps_Msg_Show();
        }*/
    }
}


